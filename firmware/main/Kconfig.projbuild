## firmware/main/Kconfig.projbuild
```kconfig
menu "camara_mqtt_live"

    config ESP_WIFI_SSID
        string "WiFi SSID"
        default "Mega-2.4G-D6AF"

    config ESP_WIFI_PASSWORD
        string "Contrasena WiFi"
        default ""

    config SERVER_IP
        string "IP del servidor MQTT (Laptop)"
        default "192.168.100.13"

    config ESP_MAXIMUM_RETRY
        int "Reintentos WiFi"
        default 5

    config WIFI_USE_ALT_MAC
        bool "Usar MAC aleatoria cada arranque"
        default n

    config WIFI_FORCE_WPA2
        bool "Forzar asociacion WPA2"
        default n

endmenu
```

## firmware/sdkconfig.defaults
```kconfig
# Placa ESP32-CAM (chip ESP32)
CONFIG_IDF_TARGET="esp32"
CONFIG_ESPTOOLPY_FLASHSIZE_4MB=y
CONFIG_ESPTOOLPY_FLASHSIZE="4MB"

# App grande para firmware con camara
CONFIG_PARTITION_TABLE_CUSTOM=y
CONFIG_PARTITION_TABLE_CUSTOM_FILENAME="partitions.csv"

# PSRAM para buffers de camara
CONFIG_ESP32_SPIRAM_SUPPORT=y
CONFIG_SPIRAM_USE_MALLOC=y

# Evitar reinicios por brownout al iniciar WiFi
CONFIG_ESP32_BROWNOUT_DET=n
```
